## boards/xtensa/mt8195_adsp/Kconfig.defconfig
```kconfig
if BOARD_MT8195_ADSP

config BOARD
	default "mt8195_adsp"

endif # BOARD_MT8195_ADSP
```

## boards/xtensa/mt8195_adsp/mt8195_adsp_defconfig
```kconfig
CONFIG_SOC_SERIES_MT8195_ADSP=y

#DEBUG
CONFIG_SYS_CLOCK_HW_CYCLES_PER_SEC=26000000
```

## drivers/interrupt_controller/Kconfig.mtk_adsp
```kconfig
config INTC_MTK_ADSP
	bool "MediaTek Audio DSP Interrupt Controller"
	help
	  Very simple cascaded interrupt controller consisting of two
	  bitfield registers (status and enable) and one mask value
	  defining valid interrupts.
```

## dts/bindings/clock/mtk,mt8195_cpuclk.yaml
```yaml
description: MediaTek Audio DSP CPU Frequency Control
compatible: "mtk,mt8195_cpuclk"
properties:
  freqs_mhz:
    type: array
    description: Available frequencies in ascending order
    required: true
  reg:
    type: array
  cg_reg:
    type: int
  pll_ctrl_reg:
    type: int
```

## dts/bindings/interrupt-controller/mtk,adsp_intc.yaml
```yaml
description: MediaTek MT8xxx Audio DSP Interrupt Controller

compatible: "mtk,adsp_intc"

include: [interrupt-controller.yaml, base.yaml]

properties:
  reg:
    required: true

  interrupts:
    required: true

  "#interrupt-cells":
    const: 3

  status_reg:
    description: register address of interrupt-is-signaled bits
    type: int
    required: true

  mask:
    description: mask of valid interrupt bits
    type: int
    required: true

interrupt-cells:
  - irq
  - sense
  - priority
```

## soc/xtensa/mtk_adsp/Kconfig
```kconfig
config SOC_FAMILY_MTK_ADSP
	bool "Mediatek MT8xxx Series Audio DSPs"
        select XTENSA
```

## soc/xtensa/mtk_adsp/mt8195_adsp/Kconfig.defconfig
```kconfig
if SOC_SERIES_MT8195_ADSP

config SOC
	default "mt8195_adsp"

config SOC_SERIES
	default "mt8195_adsp"

endif # SOC_SERIES_MT8195_ADSP
```

## soc/xtensa/mtk_adsp/mt8195_adsp/Kconfig.series
```kconfig
config SOC_SERIES_MT8195_ADSP
	bool "Mediatek 8195 Audio DSP"
	select SOC_FAMILY_MTK_ADSP
```

## tests/arch/arm/arm_switch/testcase.yaml
```yaml
tests:
  arch.arm.switch:
    arch_allow: arm
    filter: CONFIG_CORTEX_M and CONFIG_USE_SWITCH
    tags:
      - arm
```
