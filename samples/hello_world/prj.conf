## CMakeLists.txt
```
# SPDX-License-Identifier: Apache-2.0

cmake_minimum_required(VERSION 3.20.0)

find_package(Zephyr REQUIRED HINTS $ENV{ZEPHYR_BASE})
project(hello_world)

target_sources(app PRIVATE src/main.c)

# Need to unit test arch headers
target_include_directories(app PRIVATE ${ZEPHYR_BASE}/arch/${ARCH}/include)
```

## prj.conf
```kconfig
CONFIG_ASAN=y
```

## src/main.c
```c
#include <zephyr/kernel.h>
#include <zephyr/linker/linker-defs.h>
#include <zephyr/ztest.h>
#include <kernel_arch_func.h>

char stack[4096];

void *main_sh, *my_sh;

/* Aforementioned dirty trick: this value becomes the "next swtich
 * handle" examined by the interrupt exit code in lieu of whatever the
 * scheduler would return.
 */
void *next_sh;

int sum;

extern void *arm_m_last_switch_handle;

void *z_get_next_switch_handle(void *interrupted)
{
	return next_sh;
}


void my_fn(void *a, void *b, void *c)
{
	printk("%s:%d\n", __func__, __LINE__);

	void *psplim;
	__asm__ volatile("mrs %0, psplim" : "=r"(psplim));
	printk("In my_fn, PSPLIM = %p\n", psplim);

	zassert_equal((int)a, 0);
	zassert_equal((int)b, 1);
	zassert_equal((int)c, 2);

	register int A = 11;
	register int B = 12;
	register int C = 13;
	register int D = 14;
	register int E = 15;

	for (int n = 0; /**/; n++) {
		printk("%s:%d iter %d\n", __func__, __LINE__, n);

		if (arm_m_last_switch_handle) {
			printk("Using exception handle @ %p\n", arm_m_last_switch_handle);
			main_sh = arm_m_last_switch_handle;
			arm_m_last_switch_handle = NULL;
		}

		arm_m_switch(main_sh, &my_sh);

		zassert_equal(A, 11);
		zassert_equal(B, 12);
		zassert_equal(C, 13);
		zassert_equal(D, 14);
		zassert_equal(E, 15);
	}
}

/* Nothing in particular to do here except exercise the interrupt exit hook */
void my_svc(void)
{
	printk("%s:%d\n", __func__, __LINE__);
	arm_m_exc_tail();

	/* Validate that the tail hook doesn't need to be last */
	printk("   arm_m_exc_tail() has been called\n");
}

//int main(void)
ZTEST(arm_m_switch, smoke)
{
	void *psplim;

	__asm__ volatile("mrs %0, psplim" : "=r"(psplim));
	printk("In main, PSPLIM = %p\n", psplim);

	/* "register" variables don't strictly force the compiler not
	 * to spill them, but inspecting the generated code shows it's
	 * leaving them in place across the switch.
	 */
	register int A = 1;
	register int B = 2;
	register int C = 3;
	register int D = 4;
	register int E = 5;

#ifdef CONFIG_FPU_SHARING
	/* Prime all the FPU registers with something I can recognize in a debugger */
	uint32_t sregs[32];

	for(int i = 0; i < 32; i++) {
		sregs[i] = 0x3f800000 + i;
	}
	__asm__ volatile("vldm %0, {s0-s31}" :: "r"(sregs));
#endif

	sum += A + B + C + D + E;

	/* Hit an interrupt and make sure CPU state doesn't get messed up */
	printk("Invoking SVC\n");
	__asm__ volatile("svc 0");
	printk("...back\n");

	zassert_equal(A, 1);
	zassert_equal(B, 2);
	zassert_equal(C, 3);
	zassert_equal(D, 4);
	zassert_equal(E, 5);

	/* Now likewise switch to and from a foreign stack and check */
	my_sh = arm_m_new_stack(stack, sizeof(stack), my_fn, (void*)0, (void*)1, (void*)2);

	int cycles = 16;

	for(int n = 0; n < cycles; n++) {
		printk("main() switching to my_fn() (iter %d)...\n", n);
		arm_m_switch(my_sh, &main_sh);
		printk("...and back\n");

		zassert_equal(A, 1);
		zassert_equal(B, 2);
		zassert_equal(C, 3);
		zassert_equal(D, 4);
		zassert_equal(E, 5);
	}

	/* Do it again, except via interrupt this time */
	printk("Switch via interrupt...\n");
	next_sh = my_sh;
	__asm__ volatile("svc 0");
	printk("back\n");

	sum -= A + B + C + D + E;
}

/* Makes a copy of the vector table in writable RAM (it's generally in
 * a ROM section), redirects it, and hooks the SVC interrupt with our
 * own code above so we can catch direct interrupts.
 */
void *vector_hijack(void)
{
	static uint32_t __aligned(1024) vectors[256];
	uint32_t *vtor_p = (void *)0xe000ed08;
	uint32_t *vtor = (void *)*vtor_p;

	/* Vector count: _vector_start/end set by the linker. */
	int nv = (&_vector_end[0] - &_vector_start[0]) / sizeof(uint32_t);

	printk("VTOR @%p\n", vtor);
	for (int i = 0; i < nv; i++) {
		vectors[i] = vtor[i];
	}
	*vtor_p = (uint32_t) &vectors[0];
	vtor = (void *)*vtor_p;
	printk("VTOR now @%p\n", vtor);

	/* And hook the SVC call with our own function above, allowing
	 * us direct access to interrupt entry
	 */
	vtor[11] = (int)my_svc;
	printk("vtor[11] == %p (my_svc == %p)\n", (void*)vtor[11], my_svc);

	return NULL;
}

ZTEST_SUITE(arm_m_switch, NULL, vector_hijack, NULL, NULL, NULL);
```

## src/arm-m-switch.c
```c
/* Copyright 2025 The ChromiumOS Authors
 * SPDX-License-Identifier: Apache-2.0
 */
#include <zephyr/sys/util.h>
//#include <ksched.h> // FIXME, uncork once moved
#include "arm-m-switch.h"

void *z_get_next_switch_handle(void *interrupted); // FIXME: remove once ksched.h

/* The basic exception frame, popped by the hardware during return */
struct hw_frame_base {
	uint32_t r0, r1, r2, r3;
	uint32_t r12;
	uint32_t lr;
	uint32_t pc;
	uint32_t apsr;
};

/* The hardware frame pushed when entry is taken with FPU active */
struct hw_frame_fpu {
	struct hw_frame_base base;
	uint32_t s_regs[16];
	uint32_t fpscr;
	uint32_t reserved;
};

/* The hardware frame pushed when entry happens with a misaligned stack */
struct hw_frame_align {
	struct hw_frame_base base;
	uint32_t align_pad;
};

/* Both of the above */
struct hw_frame_align_fpu {
	struct hw_frame_fpu base;
	uint32_t align_pad;
};

/* Zephyr's synthesized frame used during context switch on interrupt
 * exit.  It's a minimal hardware frame plus storage for r4-11.
 */
struct synth_frame {
	uint32_t r7, r8, r9, r10, r11;
	uint32_t r4, r5, r6;		/* these match switch format */
	struct hw_frame_base base;
};

/* Zephyr's custom frame used for suspended threads, now hw-compatible */
struct switch_frame {
#ifdef CONFIG_BUILTIN_STACK_GUARD
	uint32_t psplim;
#endif
	uint32_t apsr;
	uint32_t r0, r1, r2, r3, r4, r5, r6, r7, r8, r9, r10, r11, r12;
	uint32_t lr;
	uint32_t pc;
};

/* Union of synth and switch frame, used during context switch */
union u_frame {
	struct {
		char pad[sizeof(struct switch_frame) - sizeof(struct synth_frame)];
		struct synth_frame hw;
	};
	struct switch_frame sw;
};

/* u_frame with have_fpu flag prepended (zero value), no FPU state */
struct z_frame {
#ifdef CONFIG_FPU_SHARING
	uint32_t have_fpu;
#endif
	union u_frame u;
};

/* u_frame + FPU data, with have_fpu (non-zero) */
struct z_frame_fpu {
	uint32_t have_fpu;
	uint32_t s_regs[32];
	uint32_t fpscr;
	union u_frame u;
};

/* Union of all possible stack frame formats, aligned at the top (!).
 * Note that FRAMESZ is constructed to be larger than any of them to
 * avoid having a zero-length array.  The code doesn't ever use the
 * size of this struct, it just wants to be have compiler-visible
 * offsets for in-place copies.
 */
#define FRAMESZ (4 + MAX(sizeof(struct z_frame_fpu), sizeof(struct hw_frame_align_fpu)))
#define PAD(T) char pad_##T[FRAMESZ - sizeof(struct T)]
union frame {
	struct { PAD(hw_frame_base);      struct hw_frame_base hw;          };
	struct { PAD(hw_frame_fpu);       struct hw_frame_fpu hwfp;         };
	struct { PAD(hw_frame_align);     struct hw_frame_align hw_a;       };
	struct { PAD(hw_frame_align_fpu); struct hw_frame_align_fpu hwfp_a; };
	struct { PAD(z_frame);            struct z_frame z;                 };
	struct { PAD(z_frame_fpu);        struct z_frame_fpu zfp;           };
};

/* Validate the structs are correctly top-aligned */
#define FRAME_FIELD_END(F) ((void *)&(&(((union frame *)0)->F))[1])
BUILD_ASSERT(FRAME_FIELD_END(hw) == FRAME_FIELD_END(hwfp));
BUILD_ASSERT(FRAME_FIELD_END(hw) == FRAME_FIELD_END(hw_a));
BUILD_ASSERT(FRAME_FIELD_END(hw) == FRAME_FIELD_END(hwfp_a));
BUILD_ASSERT(FRAME_FIELD_END(hw) == FRAME_FIELD_END(z));
BUILD_ASSERT(FRAME_FIELD_END(hw) == FRAME_FIELD_END(zfp));

/* Global pointers to the frame locations for the callee-saved
 * registers.  Set in arm_m_must_switch(), and used by the fixup
 * assembly in arm_m_exc_exit.
 */
struct { void *out, *in; } arm_m_cs_ptrs;

/* Unit test hook, unused in production */
void *arm_m_last_switch_handle;

/* Emits an in-place copy from a hw_frame_base to a switch_frame */
#define HW_TO_SWITCH(hw, sw) do {					\
	uint32_t r0 = hw.r0, r1 = hw.r1, r2 = hw.r2, r3 = hw.r3; 	\
	uint32_t r12 = hw.r12, lr = hw.lr, pc = hw.pc, apsr = hw.apsr;	\
	pc |= 1; /* thumb bit! */					\
	sw.r0 = r0; sw.r1 = r1; sw.r2 = r2; sw.r3 = r3;			\
	sw.r12 = r12; sw.lr = lr; sw.pc = pc; sw.apsr = apsr;		\
} while(false)

/* Emits an in-place copy from a switch_frame to a synth_frame */
#define SWITCH_TO_SYNTH(sw, syn) do {					\
	struct synth_frame syntmp = {					\
		.r4 = sw.r4, .r5 = sw.r5, .r6 = sw.r6, .r7 = sw.r7,	\
		.r8 = sw.r8, .r9 = sw.r9, .r10 = sw.r10, .r11 = sw.r11,	\
		.base.r0 = sw.r0, .base.r1 = sw.r1, .base.r2 = sw.r2,	\
		.base.r3 = sw.r3, .base.r12 = sw.r12, .base.lr = sw.lr,	\
		.base.pc = sw.pc, .base.apsr = sw.apsr,			\
	};								\
	syn = syntmp;							\
} while(false)

/* Reports if the passed return address is a valid EXC_RETURN (high
 * four bits set) that will restore to the PSP running in thread mode
 * (low four bits == 0xd).  That is an interrupted Zephyr thread
 * context.  For everything else, we just return directly via the
 * hardware-pushed stack frame with no special handling. See ARMv7M
 * manual B1.5.8.
 */
static bool arm_m_is_thread_return(uint32_t lr)
{
	return (lr & 0xf000000f) == 0xf000000d;
}

/* Returns true if the EXC_RETURN address indicates a FPU subframe was
 * pushed to the stack.  See ARMv6M manual B1.5.8.
 */
static bool arm_m_fpu_state_pushed(uint32_t lr)
{
	return IS_ENABLED(CONFIG_CPU_HAS_FPU) ? !!(lr & 0x08000000) : false;
}

#ifdef CONFIG_BUILTIN_STACK_GUARD
#define PSPLIM(f) ((f)->z.u.sw.psplim)
#else
#define PSPLIM(f) 0
#endif

/* Converts, in place, a pickled "switch" frame from a suspended
 * thread to a "synthesized" format that can be restored by the CPU
 * hardware on exception exit.
 */
static void *arm_m_switch_to_cpu(void *sp)
{
	union frame *f;
	uint32_t splim;

#ifdef CONFIG_FPU_SHARING
	/* When FPU switching is enabled, the suspended handle always
	 * points to the have_fpu word, which will be followed by FPU
	 * state if non-zero.
	 */
	bool have_fpu = (*(uint32_t *)sp) != 0;

	if (have_fpu) {
		f = CONTAINER_OF(sp, union frame, zfp.have_fpu);
		splim = PSPLIM(f);
		__asm__ volatile("vldm %0, {s0-s31}" :: "r"(&f->zfp.s_regs[0]));
		SWITCH_TO_SYNTH(f->zfp.u.sw, f->zfp.u.hw);
	} else {
		f = CONTAINER_OF(sp, union frame, z.have_fpu);
		splim = PSPLIM(f);
		SWITCH_TO_SYNTH(f->z.u.sw, f->zfp.u.hw);
	}
#else
	f = CONTAINER_OF(sp, union frame, z.u.sw);
	splim = PSPLIM(f);
	SWITCH_TO_SYNTH(f->z.u.sw, f->z.u.hw);
#endif

#ifdef CONFIG_BUILTIN_STACK_GUARD
	__asm__ volatile("msr psplim, %0" :: "r"(splim));
#endif

	/* Mark the callee-saved pointer for the fixup assembly.  Note
         * funny layout that puts r7 first!
         */
        arm_m_cs_ptrs.in = &f->z.u.hw.r7;

	return &f->z.u.hw.base;
}

static void fpu_cs_copy(struct hw_frame_fpu *src, struct z_frame_fpu *dst)
{
	for (int i = 0; IS_ENABLED(CONFIG_FPU_SHARING) && i < 16; i++) {
		dst->s_regs[i] = src->s_regs[i];
	}
}

/* Converts, in-place, a CPU-spilled ("hardware") exception entry
 * frame to our ("zephyr") switch handle format such that the thread
 * can be suspended
 */
static void *arm_m_cpu_to_switch(void *sp, bool fpu)
{
	union frame *f;
	struct hw_frame_base *base = sp;
	bool padded = (base->apsr & 0x200);
	uint32_t fpscr;

	if (fpu && IS_ENABLED(CONFIG_FPU_SHARING)) {
		uint32_t dummy;

		/* Lazy FPU stacking is enabled, so before we touch
		 * the stack frame we have to tickle the FPU to force
		 * it to spill the caller-save registers.  Then clear
		 * CONTROL.FPCA which gets set again by that instruction.
		 */
		__asm__ volatile("vmov %0, s0;"
				 "mrs %0, control;"
				 "bic %0, %0, #4;"
				 "msr control, %0;"
				 :: "r"(dummy));
	}

	if (IS_ENABLED(CONFIG_FPU_SHARING) && fpu) {
		fpscr = CONTAINER_OF(sp, struct hw_frame_fpu, base)->fpscr;
	}

	/* There are four (!) different offsets from the interrupted
	 * stack at which the hardware frame might be found at
	 * runtime.  These expansions let the compiler generate
	 * optimized in-place copies for each.  In practice it does a
	 * pretty good job, much better than a double-copy via an
	 * intermediate buffer.  Note that when FPU state is spilled
	 * we must copy the 16 spilled registers first, to make room
	 * for the copy.
	 */
	if (!fpu && !padded) {
		f = CONTAINER_OF(sp, union frame, hw.r0);
		HW_TO_SWITCH(f->hw, f->z.u.sw);
	} else if (!fpu && padded) {
		f = CONTAINER_OF(sp, union frame, hw_a.base.r0);
		HW_TO_SWITCH(f->hw_a.base, f->z.u.sw);
	} else if (fpu && !padded) {
		f = CONTAINER_OF(sp, union frame, hwfp.base.r0);
		fpu_cs_copy(&f->hwfp, &f->zfp);
		HW_TO_SWITCH(f->hwfp.base, f->z.u.sw);
	} else if (fpu && padded) {
		f = CONTAINER_OF(sp, union frame, hwfp_a.base.base.r0);
		fpu_cs_copy(&f->hwfp_a.base, &f->zfp);
		HW_TO_SWITCH(f->hwfp_a.base.base, f->z.u.sw);
	}

#ifdef CONFIG_BUILTIN_STACK_GUARD
	__asm__ volatile("mrs %0, psplim" : "=r"(f->z.u.sw.psplim));
#endif

        /* Mark the callee-saved pointer for the fixup assembly */
        arm_m_cs_ptrs.out = &f->z.u.sw.r4;

#ifdef CONFIG_FPU_SHARING
	if (fpu) {
		__asm__ volatile("vstm %0, {s16-s31}" :: "r"(&f->zfp.s_regs[16]));
		f->zfp.fpscr = fpscr;
		f->zfp.have_fpu = true;
		return &f->zfp.have_fpu;
	} else {
		f->z.have_fpu = false;
		return &f->z.have_fpu;
	}
#endif
	return &f->z.u.sw;
}

/* Constructs a new stack in the provided region (aligned to and in
 * units of 8 bytes per AAPCS) and returns the switch handle
 */
void *arm_m_new_stack(char *base, uint32_t sz, void *entry,
		      void *arg0, void *arg1, void *arg2)
{
	struct switch_frame *sw;
	uint32_t baddr;

	baddr = ((uint32_t)base + 7) & ~7;
	sz = ((uint32_t)(base + sz) - baddr) & ~7;

	if (sz < sizeof(struct switch_frame)) {
		return NULL;
	}

	/* Note: a useful trick here would be to initialize LR to
	 * point to cleanup code, avoiding the need for the
	 * z_thread_entry wrapper, saving a few words of stack frame
	 * and a few cycles on thread entry.
	 */
	sw = (void *)(baddr + sz - sizeof(*sw));
	*sw = (struct switch_frame) {
		IF_ENABLED(CONFIG_BUILTIN_STACK_GUARD, (.psplim = baddr,))
		.r0 = (uint32_t) arg0,
		.r1 = (uint32_t) arg1,
		.r2 = (uint32_t) arg2,
		.pc = ((uint32_t) entry) | 1, /* set thumb bit! */
		.apsr = 0x1000000,            /* thumb bit here too! */
	};

	if (IS_ENABLED(CONFIG_FPU_SHARING)) {
		return CONTAINER_OF(sw, struct z_frame, u.sw);
	}
	return sw;
}

bool arm_m_must_switch(uint32_t lr)
{
	if (!arm_m_is_thread_return(lr)) {
		return false;
	}

	void *last, *next = z_get_next_switch_handle(NULL);

	if (next == NULL) {
		return false;
	}

	bool fpu = arm_m_fpu_state_pushed(lr);

	/* Rejigger the frame we're pickling, and unpickle the new
	 * thread we're returning into
	 */
	__asm__ volatile("mrs %0, psp" : "=r"(last));
	last = arm_m_cpu_to_switch(last, fpu);
	next = arm_m_switch_to_cpu(next);
	__asm__ volatile("msr psp, %0" :: "r"(next));

#if !defined(CONFIG_MULTITHREADING)
	arm_m_last_switch_handle = last;
#elif defined(CONFIG_USE_SWITCH)
	arch_current_thread()->base.switch_handle = last;
#endif

	return true;
}

/* We arrive here on "return" from exception handlers on a context
 * switch. Our job is to save the interrupted r4-r11 of the outgoing
 * thread (which can't be done in the C function context because we
 * can't control the compiler spill behavior of callee-saved
 * registers), restore the same registers from the incoming thread,
 * and then return via BX to a constructed exception return value.  We
 * can use any of r0-r3/r12/lr because they have already been saved.
 * FPU restore is handled in software, so we always use a constant
 * EXC_RETURN value indicating an integer-only restore.
 */
__asm__(".globl arm_m_exc_exit;"
	"arm_m_exc_exit:;"
	"  ldr r0, =arm_m_cs_ptrs;"
	"  ldm r0, {r0, r1};" /* fields: out, in */
	"  mov lr, #0xfffffffd;"
	"  stm r0, {r4-r11};"
	"  ldm r1!, {r7-r11};"
	"  ldm r1, {r4-r6};"
	"  bx lr;");
```

## src/arm-m-switch.h
```c
/* Copyright 2025 The ChromiumOS Authors
 * SPDX-License-Identifier: Apache-2.0
 */
#ifndef _ZEPHYR_ARCH_ARM_M_SWITCH_H
#define _ZEPHYR_ARCH_ARM_M_SWITCH_H

#include <stdint.h>
#include <zephyr/kernel/thread.h>
#include <zephyr/kernel/thread_stack.h>

void *arm_m_new_stack(char *base, uint32_t sz, void *entry,
		      void *arg0, void *arg1, void *arg2);

bool arm_m_must_switch(uint32_t lr);

void arm_m_exc_exit(void);

extern uintptr_t z_arm_tls_ptr;

K_KERNEL_STACK_ARRAY_DECLARE(z_interrupt_stacks, CONFIG_MP_MAX_NUM_CPUS, CONFIG_ISR_STACK_SIZE);

static inline void arm_m_exc_tail(void)
{
	/* Dirty trickery: we load this ISR's LR register (which
	 * contains our interrupt return token) from the runtime stack
	 * frame pushed to the top of the interrupt stack on entry.
	 * Check it to see if we can/should return to a different
	 * thread (which will then have magically pickled our
	 * interrupted stack into "switch" format), and then if so:
	 * CLOBBER it with the address of our fixup code so that we
	 * can finish saving the interrupted r4-r11 registers before
	 * returning from the interrupt.
	 *
	 * Obviously this only works if the ISR is "ABI-compliant
	 * enough".  It doesn't have to have pushed a complete frame,
	 * but it does have to have put LR into its standard location.
	 * In practice generated code does (because it has to store LR
	 * somewhere so it can call other functions and then pop it to
	 * return), so this works even on code built with
	 * -fomit-frame-pointer.  If an app needs a direct interrupt
	 * and can't meet these requirents, it can always skip this
	 * call and return directly (reschedule is optional for direct
	 * interrupts anyway).
	 */
	uint32_t *stack_top = (void *)(K_KERNEL_STACK_BUFFER(z_interrupt_stacks[0]) +
				       K_KERNEL_STACK_SIZEOF(z_interrupt_stacks[0]));
	uint32_t *lr_ptr = &stack_top[-1];

	if (arm_m_must_switch(*lr_ptr)) {
		*lr_ptr = 1 | (uint32_t)arm_m_exc_exit; /* thumb bit! */
	}
}

static ALWAYS_INLINE void arm_m_switch(void *switch_to, void **switched_from)
{
#if defined(CONFIG_USERSPACE) || defined(CONFIG_MPU_STACK_GUARD)
	z_arm_configure_dynamic_mpu_regions(_current);
#endif
#ifdef CONFIG_THREAD_LOCAL_STORAGE
	z_arm_tls_ptr = _current->tls;
#endif

	/* new switch handle in r4, old switch handle pointer in r5.
	 * r6-r8 are used by the code here, and r9-r11 are
	 * unsaved/clobbered (they are very likely to be caller-saved
	 * registers in the enclosing function that the compiler can
	 * avoid using, i.e. we can let it make the call and avoid a
	 * double-spill).  But all registers are restored fully
	 * (because we might be switching to an interrupt-saved frame)
	 */
	register uint32_t r4 __asm__("r4") = (uint32_t) switch_to;
	register uint32_t r5 __asm__("r5") = (uint32_t) switched_from;
	__asm__ volatile(
		 /* Construct and push a {r12, lr, pc} group at the top
		  * of the frame, where PC points to the final restore location
		  * at the end of this sequence.
		  */
		 "mov r6, r12;"
		 "mov r7, lr;"
		 "ldr r8, =3f;"           /* address of restore PC */
		 "add r8, r8, #1;"        /* set thumb bit */
		 "push {r6-r8};"
		 "sub sp, sp, #24;"       /* skip over space for r6-r11 */
		 "push {r0-r5};"
		 "mov r2, #0x01000000;"   /* APSR (only care about thumb bit) */
		 "mov r0, #0;"            /* Leave r0 zero for code blow */
#ifdef CONFIG_BUILTIN_STACK_GUARD
		 "mrs r1, psplim;"
		 "push {r1-r2};"
		 "msr psplim, r0;"        /* zero it so we can move the stack */
#else
		 "push {r2};"
#endif

#ifdef CONFIG_FPU_SHARING
		 /* Push FPU state (if active) to our outgoing stack */
		 "   mrs r8, control;"    /* read CONTROL.FPCA */
		 "   and r7, r8, #4;"     /* r7 == have_fpu */
		 "   cbz r7, 1f;"
		 "   bic r8, r8, #4;"     /* clear CONTROL.FPCA */
		 "   msr control, r8;"
		 "   vmrs r6, fpscr;"
		 "   push {r6};"
		 "   vpush {s0-s31};"
		 "1: push {r7};"          /* have_fpu word */

		 /* Pop FPU state (if present) from incoming frame in r4 */
		 "   ldm r4!, {r7};"      /* have_fpu word */
		 "   cbz r7, 2f;"
		 "   vldm r4!, {s0-s31};" /* (note: sets FPCA bit for us) */
		 "   ldm r4!, {r6};"
		 "   vmsr fpscr, r6;"
		 "2:;"
#endif
		 /* Save the outgoing switch handle (which is SP), swap stacks,
		  * and enable interrupts.  The restore process is
		  * interruptible code (running in the incoming thread) once
		  * the stack is valid.
		  */
		 "str sp, [r5];"
		 "mov sp, r4;"
		 "msr basepri, r0;"

		 /* Restore is super simple: pop the flags (and stack limit if
		  * enabled) then slurp in the whole GPR set in two
		  * instructions. (The instruction encoding disallows popping
		  * both LR and PC in a single instruction)
		  */
#ifdef CONFIG_BUILTIN_STACK_GUARD
		 "pop {r1-r2};"
		 "msr psplim, r1;"
#else
		 "pop {r2};"
#endif
		 "msr apsr_nzcvq, r2;" /* bonkers syntax */
		 "pop {r0-r12, lr};"
		 "pop {pc};"

		 "3:" /* Label for restore address */
		 :: "r"(r4), "r"(r5) :
		  "r6", "r7", "r8", "r9", "r10", "r11");
}

#endif /* _ZEPHYR_ARCH_ARM_M_SWITCH_H */
```

## src/util.c
```c
/* Copyright (c) 2022 Google LLC.
 * SPDX-License-Identifier: Apache-2.0
 */

/* These live in their own file to prevent the optimizer from "fixing" them */

#define ARRAYSZ 12

int global_array[ARRAYSZ];

int *bad_ptr;

int read_elem(int *array, int idx)
{
	return array[idx];
}

void write_elem(int *array, int idx, int val)
{
	array[idx] = val;
}

void set_bad_ptr(void)
{
	int val[3]; /* extra elements so writes don't actually smash the stack! */
	bad_ptr = &val[1];
}
```
